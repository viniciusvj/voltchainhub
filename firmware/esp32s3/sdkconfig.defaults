## firmware/esp32s3/sdkconfig.defaults
```kconfig
# Minimal defaults for the VoltchainHub node bring-up.
CONFIG_IDF_TARGET="esp32s3"
CONFIG_ESP_MAIN_TASK_STACK_SIZE=4096
CONFIG_FREERTOS_HZ=1000
# Security hardening (enable for production units; see the design doc):
# CONFIG_SECURE_BOOT=y
# CONFIG_SECURE_FLASH_ENC_ENABLED=y
```
